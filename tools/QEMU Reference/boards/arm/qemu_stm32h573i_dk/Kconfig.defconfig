## tools/QEMU Reference/boards/arm/qemu_stm32h573i_dk/Kconfig.defconfig
```kconfig
# SPDX-License-Identifier: Apache-2.0

if BOARD_QEMU_STM32H573I_DK

config BOARD
	default "qemu_stm32h573i_dk"

config SYS_CLOCK_HW_CYCLES_PER_SEC
	default 25000000

config CONSOLE
	default y

config UART_CONSOLE
	default y

config SERIAL
	default y

config GPIO
	default y

# QEMU machine configuration
config QEMU_TARGET
	default y

# Ensure Cortex-M33 is properly configured
config CPU_CORTEX_M33
	default y

config CPU_HAS_FPU
	default y

config CPU_HAS_FPU_DOUBLE_PRECISION
	default y

endif # BOARD_QEMU_STM32H573I_DK
```

## tools/Zephyr/stm32h573i_dk_app/boards/arm/qemu_stm32h573i_dk/Kconfig.board
```kconfig
# SPDX-License-Identifier: Apache-2.0

config BOARD_QEMU_STM32H573I_DK
	bool "QEMU Emulation for STM32H573I-DK"
	select QEMU_TARGET
	select CPU_CORTEX_M33
	select CPU_HAS_FPU
	select CPU_HAS_FPU_DOUBLE_PRECISION
	select SOC_SERIES_MPS2
	select BOARD_MPS2_AN500
```
